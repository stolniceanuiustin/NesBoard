## NES_Emulator_Zephyr/west.yml
```yaml
manifest:
  remotes:
    - name: stolniceanuiustin
      url-base: https://github.com/stolniceanuiustin

  projects:
    - name: zephyr
      remote: stolniceanuiustin
      revision: af0c8e4a786
      import: true

  self:
    path: NES_Emulator_Zephyr
```
